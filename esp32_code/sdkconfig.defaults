## esp32_code/sdkconfig.defaults
```kconfig
# ESP32-S3 DevKit: use native USB for console I/O (typed commands)
CONFIG_ESP_CONSOLE_USB_SERIAL_JTAG=y
CONFIG_ESP_CONSOLE_SECONDARY_NONE=y
CONFIG_ESP_CONSOLE_UART_BAUDRATE=115200
CONFIG_LOG_DEFAULT_LEVEL_INFO=y

# FreeRTOS
CONFIG_FREERTOS_HZ=1000

# Edge Impulse continuous inference needs a large main-task stack
CONFIG_ESP_MAIN_TASK_STACK_SIZE=49152
```
